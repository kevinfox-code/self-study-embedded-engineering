/**
 * @file motor_math.c
 * @brief Fixed-point arithmetic kernel and trigonometry implementation.
 *
 * Layer: A  Dependencies: motor_types.h, motor_math.h only.
 * All public functions tagged [ISR] are ISR-safe (no blocking, pure math).
 *
 * Trig implementation notes:
 *   foc_sin/foc_cos: quarter-wave reduction → LUT lookup + linear interpolation.
 *     Angle encoding: 2^32 = 1 full electrical revolution.
 *     Quarter index: bits [31:30] select quadrant; bits [29:22] (8 MSBs of
 *     fractional part) index the 256-entry LUT; bits [21:0] provide the
 *     interpolation fraction.
 *
 *   foc_atan2: 8-octant decomposition, LUT of 257 atan(t) values over [0,1],
 *     linear interpolation.  Decision D-004.
 */

#include "foc/motor_math.h"

#include <stdint.h>  /* int64_t */

/* Forward declaration of LUT table (defined in motor_math_lut.c). */
extern const int16_t foc_sin_lut[257];

/* =========================================================================
 * Internal atan LUT — 257 entries, angle_t units, for t in [0,1].
 * atan(t) expressed as angle_t (2^32 = 2π).
 * Generated inline at compile time from fp64 literals (compile-time only).
 * ====================================================================== */

/* Convert atan(i/256) radians to angle_t units (2^32 = 2pi). */
/* Table generated by: round(atan(i/256.0) / (2*pi) * 2^32)        */
/* for i = 0 .. 256                                                  */
static const uint32_t s_atan_lut[257] = {
        0u,  2670163u,  5340245u,  8010164u, 10679838u,
 13349187u, 16018129u, 18686582u, 21354465u, 24021698u,
 26688200u, 29353889u, 32018685u, 34682507u, 37345276u,
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535533213u,536870912u};

/* =========================================================================
 * Q16.16 arithmetic
 * ====================================================================== */

q16_t q16_mul(q16_t a, q16_t b)
{
    int64_t prod = (int64_t)a * (int64_t)b;
    /* Round half-away from zero.
     * For prod >= 0: (prod + 0x8000) >> 16.
     * For prod < 0:  -((-prod + 0x8000) >> 16).
     * This avoids the off-by-one that occurs when prod is a negative exact
     * multiple of 65536 and arithmetic right-shift truncates toward -inf. */
    int64_t rounded;
    if (prod >= 0) {
        rounded = (prod + (int64_t)0x8000) >> 16;
    } else {
        rounded = -((-prod + (int64_t)0x8000) >> 16);
    }
    if (rounded > (int64_t)Q16_MAX) {
        FOC_SAT_HOOK("q16_mul");
        return Q16_MAX;
    }
    /* Saturate on either underflow OR when the result equals the asymmetric
     * negative maximum (-Q16_MAX), which maps to Q16_MIN in two's complement.
     * This preserves symmetric saturation semantics (Q16_MAX * -1 → Q16_MIN). */
    if (rounded < (int64_t)(int32_t)Q16_MIN ||
        rounded == -(int64_t)Q16_MAX) {
        FOC_SAT_HOOK("q16_mul");
        return Q16_MIN;
    }
    return (q16_t)rounded;
}

q16_t q16_mul_ns(q16_t a, q16_t b)
{
    /* Range-proof must be asserted at every call site.
     * No rounding, no saturation — caller is responsible. */
    return (q16_t)(((int64_t)a * (int64_t)b) >> 16);
}

q16_t q16_mul_q15(q16_t a, q15_t b)
{
    /* Q16.16 × Q1.15 → Q16.16:  result = round(a * b / 32768), saturated.
     * Use round-half-away-from-zero, same convention as q16_mul. */
    int64_t prod = (int64_t)a * (int64_t)b;
    int64_t rounded;
    if (prod >= 0) {
        rounded = (prod + (int64_t)0x4000) >> 15;
    } else {
        rounded = -((-prod + (int64_t)0x4000) >> 15);
    }
    if (rounded > (int64_t)Q16_MAX) {
        FOC_SAT_HOOK("q16_mul_q15");
        return Q16_MAX;
    }
    if (rounded < (int64_t)(int32_t)Q16_MIN) {
        FOC_SAT_HOOK("q16_mul_q15");
        return Q16_MIN;
    }
    return (q16_t)rounded;
}

q16_t q16_div(q16_t a, q16_t b)
{
    if (b == 0) {
        FOC_SAT_HOOK("q16_div_zero");
        return (a >= 0) ? Q16_MAX : Q16_MIN;
    }
    int64_t num = ((int64_t)a << 16);
    int64_t result = num / (int64_t)b;
    if (result > (int64_t)Q16_MAX) {
        FOC_SAT_HOOK("q16_div");
        return Q16_MAX;
    }
    if (result < (int64_t)(int32_t)Q16_MIN) {
        FOC_SAT_HOOK("q16_div");
        return Q16_MIN;
    }
    return (q16_t)result;
}

q16_t q16_abs(q16_t v)
{
    if (v == Q16_MIN) {
        FOC_SAT_HOOK("q16_abs");
        return Q16_MAX;
    }
    return (v < 0) ? -v : v;
}

q16_t q16_min(q16_t a, q16_t b)
{
    return (a < b) ? a : b;
}

q16_t q16_max(q16_t a, q16_t b)
{
    return (a > b) ? a : b;
}

q16_t q16_clamp(q16_t v, q16_t lo, q16_t hi)
{
    if (v < lo) return lo;
    if (v > hi) return hi;
    return v;
}

q16_t q16_sqrt(q16_t x)
{
    /* Integer Newton-Raphson on Q16.16.
     * Input x is Q16.16 (e.g. Q16(4.0) → result Q16(2.0)).
     * We compute floor(sqrt(x_raw)) where x_raw = x (as int32_t raw bits),
     * then interpret as Q16.16.
     * sqrt(Q16.16 value V) = sqrt(V * 2^16) / 2^8 in raw integer terms.
     * Equivalently: let r = integer sqrt of (x as uint32_t), result = r << 8.
     *
     * WCET: 16 Newton iterations — deterministic.
     */
    if (x <= 0) {
        return 0;
    }
    /* Compute integer sqrt of x treated as uint32 (= sqrt(value * 65536)). */
    uint32_t ux = (uint32_t)x;
    /* Initial estimate via leading-bit position. */
    uint32_t guess = 1u;
    uint32_t tmp = ux;
    while (tmp > 1u) {
        tmp >>= 2;
        guess <<= 1;
    }
    /* 16 Newton-Raphson iterations (overkill but ensures convergence). */
    uint32_t i;
    for (i = 0u; i < 16u; i++) {
        if (guess == 0u) { break; }
        guess = (guess + ux / guess) >> 1;
    }
    /* Convert: result = guess * 2^8 (because sqrt(x * 2^16) = sqrt(x) * 2^8,
     * and we want Q16.16 output = sqrt(x_Q16) * 2^16 = sqrt(x_raw) * 2^8). */
    return (q16_t)(guess << 8);
}

q16_t q16_from_raw_scaled(int32_t raw, q16_t gain, q16_t offset)
{
    /* result = raw * gain + offset, Q16.16
     * raw is a plain integer (e.g. ADC count), not a Q16 value.
     * Multiplying integer × Q16.16 directly yields a Q16.16 result:
     *   raw (integer) × gain (Q16.16 = real_val × 65536)
     *   = raw × real_val × 65536 = Q16.16(raw × real_val).
     * No shift needed; use 64-bit for overflow safety with large raw values.
     */
    int64_t scaled64 = (int64_t)raw * (int64_t)gain;
    /* Saturating add of offset. */
    int64_t sum = scaled64 + (int64_t)offset;
    if (sum > (int64_t)Q16_MAX) return Q16_MAX;
    if (sum < (int64_t)(int32_t)Q16_MIN) return Q16_MIN;
    return (q16_t)sum;
}

/* =========================================================================
 * Trig implementation
 * ====================================================================== */

/* Quarter-index extraction:
 *   Bits [31:30] = quadrant (0..3)
 *   Bits [29:22] = LUT index within quarter (0..255)
 *   Bits [21: 0] = interpolation fraction (0..4194303 ~ 2^22 - 1)
 */
#define TRIG_QUAD_SHIFT   30u
#define TRIG_IDX_SHIFT    22u
#define TRIG_IDX_MASK     0xFFu
#define TRIG_FRAC_MASK    0x3FFFFFu
#define TRIG_FRAC_BITS    22u

static q15_t trig_lookup(angle_t theta_mod_quarter)
{
    /* theta_mod_quarter: angle within one quarter-wave (bits [29:0] already). */
    uint32_t idx  = (theta_mod_quarter >> TRIG_IDX_SHIFT) & TRIG_IDX_MASK;
    uint32_t frac = theta_mod_quarter & TRIG_FRAC_MASK;

    int32_t y0 = (int32_t)foc_sin_lut[idx];
    int32_t y1 = (int32_t)foc_sin_lut[idx + 1u];
    /* Linear interpolation: result = y0 + (y1-y0)*frac / 2^22. */
    int32_t delta = y1 - y0;
    int32_t interp = y0 + (int32_t)(((int64_t)delta * (int64_t)frac) >> TRIG_FRAC_BITS);
    /* Clamp to Q15 range (very unlikely to be needed but defensive). */
    if (interp > (int32_t)Q15_ONE)  return Q15_ONE;
    if (interp < (int32_t)Q15_MIN)  return (q15_t)Q15_MIN;
    return (q15_t)interp;
}

q15_t foc_sin(angle_t theta)
{
    uint32_t quad = theta >> TRIG_QUAD_SHIFT;      /* 0..3 */
    uint32_t rem  = theta & 0x3FFFFFFFu;           /* angle within quarter */

    q15_t mag;
    switch (quad & 3u) {
    case 0u: mag =  trig_lookup(rem);                         break;
    case 1u: mag =  trig_lookup(0x3FFFFFFFu - rem);          break;
    case 2u: mag = (q15_t)(-trig_lookup(rem));               break;
    default: mag = (q15_t)(-trig_lookup(0x3FFFFFFFu - rem)); break;
    }
    return mag;
}

q15_t foc_cos(angle_t theta)
{
    /* cos(θ) = sin(θ + π/2) */
    return foc_sin(theta + (angle_t)0x40000000u);
}

void foc_sincos(angle_t theta, q15_t *s_out, q15_t *c_out)
{
    *s_out = foc_sin(theta);
    *c_out = foc_cos(theta);
}

angle_t foc_atan2(q16_t y, q16_t x)
{
    /*
     * 8-octant atan implementation using s_atan_lut.
     *
     * Strategy:
     *   1. Determine octant from signs of x, y and |x| vs |y|.
     *   2. Reduce to first octant (0 ≤ t ≤ 1, t = min/max of |x|,|y|).
     *   3. Index atan_lut[256·t] + interpolate.
     *   4. Reconstruct full angle.
     *
     * Result: angle_t (0..2^32 = 0..2π).
     */
    int32_t ax = (x < 0) ? ((x == Q16_MIN) ? Q16_MAX : -x) : x;
    int32_t ay = (y < 0) ? ((y == Q16_MIN) ? Q16_MAX : -y) : y;

    /* Handle degenerate cases. */
    if (ax == 0 && ay == 0) return 0u;

    /* Octant flags. */
    int swap  = (ay > ax) ? 1 : 0;
    int32_t num = swap ? ax : ay;
    int32_t den = swap ? ay : ax;
    if (den == 0) den = 1;

    /* Compute t in Q16.16 ∈ [0, Q16_ONE] */
    q16_t t = q16_div((q16_t)num, (q16_t)den);
    /* Scale t to index range [0..256]. */
    /* t is Q16.16; t/Q16_ONE * 256 = t >> 8. */
    uint32_t t_raw = (uint32_t)((t < 0) ? 0 : t); /* clamp — t >= 0 always here */
    uint32_t idx  = t_raw >> 8;       /* integer index [0..256] */
    uint32_t frac = t_raw & 0xFFu;    /* 8-bit fraction */
    if (idx > 255u) { idx = 255u; frac = 0u; }

    uint32_t a0 = s_atan_lut[idx];
    uint32_t a1 = s_atan_lut[idx + 1u];
    uint32_t atan_val = a0 + (uint32_t)(((uint64_t)(a1 - a0) * frac) >> 8);

    /* Reconstruct full angle from octant. */
    /* angle_t(π/4) = 0x20000000 */
    /* angle_t(π/2) = 0x40000000 */
    /* angle_t(π)   = 0x80000000 */
    const uint32_t PI2 = 0x40000000u;
    const uint32_t PI  = 0x80000000u;

    uint32_t angle;
    if (!swap) {
        /* t = |y|/|x|, atan is in [0, π/4] */
        angle = atan_val;
    } else {
        /* t = |x|/|y|, atan is in [π/4, π/2] */
        angle = PI2 - atan_val;
    }

    /* Apply quadrant reconstruction. */
    if (x >= 0 && y >= 0) {
        /* Q1: angle in [0, π/2] — already correct */
    } else if (x < 0 && y >= 0) {
        /* Q2: π - angle */
        angle = PI - angle;
    } else if (x < 0 && y < 0) {
        /* Q3: π + angle */
        angle = PI + angle;
    } else {
        /* Q4 (x >= 0, y < 0): 2π - angle (wraps naturally) */
        angle = (uint32_t)(0u - angle);
    }
    return (angle_t)angle;
}

/* =========================================================================
 * LUT sanity self-check
 * ====================================================================== */

foc_status_t foc_math_lut_check(void)
{
    /* Spot-check known values. */
    /* sin(0) = 0 */
    if (foc_sin(0u) != 0) return FOC_EFAULT;
    /* sin(π/2) ≈ 32767 (Q15_ONE) */
    q15_t s90 = foc_sin(0x40000000u);
    if (s90 != Q15_ONE) return FOC_EFAULT;
    /* sin(π) ≈ 0 (tolerance: ≤ 4 LSB) */
    q15_t s180 = foc_sin(0x80000000u);
    int32_t err180 = (int32_t)s180;
    if (err180 < -4 || err180 > 4) return FOC_EFAULT;
    /* sin(3π/2) ≈ -32767 */
    q15_t s270 = foc_sin(0xC0000000u);
    if (s270 > -32760) return FOC_EFAULT;
    /* cos(0) = Q15_ONE */
    if (foc_cos(0u) != Q15_ONE) return FOC_EFAULT;
    return FOC_OK;
}
